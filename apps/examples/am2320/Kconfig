## apps/examples/am2320/Kconfig
```kconfig
#
# For a description of the syntax of this configuration file,
# see the file kconfig-language.txt in the NuttX tools repository.
#

config EXAMPLES_AM2320
	bool "AM2320 driver example"
	default n
	---help---
		Enable the AM2320 driversexample

if EXAMPLES_AM2320


config EXAMPLES_AM2320_PROGNAME
	string "Program name"
	default "am2320"
	depends on BUILD_KERNEL
	---help---
		This is the name of the program that will be use when the NSH ELF
		program is installed.

config EXAMPLES_AM2320_PRIORITY
	int "AM2320 task priority"
	default 100

config EXAMPLES_AM2320_STACKSIZE
	int "AM2320 stack size"
	default 2048

config EXAMPLES_AM2320_DEVPATH
	string "AM2320 device path"
	default "/dev/i2c2"


endif # EXAMPLES_AM2320
```

## apps/examples/setpin/Kconfig
```kconfig
#
# For a description of the syntax of this configuration file,
# see the file kconfig-language.txt in the NuttX tools repository.
#

config EXAMPLES_SETPIN
	bool "SETPIN example lsh"
	default n
	---help---
		Enable the lsh led example

if EXAMPLES_SETPIN

config EXAMPLES_SETPIN_PROGNAME
	string "Program name"
	default "setpin"
	depends on BUILD_KERNEL
	---help---
		This is the name of the program that will be use when the NSH ELF
		program is installed.

config EXAMPLES_SETPIN_PRIORITY
	int "MYLED task priority"
	default 100

config EXAMPLES_SETPIN_STACKSIZE
	int "MYLED stack size"
	default 2048

endif
```

## apps/examples/slave_boardctl_myleds/Kconfig
```kconfig
#
# For a description of the syntax of this configuration file,
# see the file kconfig-language.txt in the NuttX tools repository.
#

config EXAMPLES_SLAVE_BOARDCTL_MYLEDS
	bool "MY SLAVE BOARDCTL LED driver example"
	default n
	---help---
		Enable the LED driversexample

if EXAMPLES_SLAVE_BOARDCTL_MYLEDS


config EXAMPLES_SLAVE_BOARDCTL_MYLEDS_PROGNAME
	string "Program name"
	default "slave boardctl myleds"
	depends on BUILD_KERNEL
	---help---
		This is the name of the program that will be use when the NSH ELF
		program is installed.

config EXAMPLES_SLAVE_BOARDCTL_MYLEDS_PRIORITY
	int "SLAVE BOARDCTL MYLED task priority"
	default 100

config EXAMPLES_SLAVE_BOARDCTL_MYLEDS_STACKSIZE
	int "SLAVE BOARDCTL MYLED stack size"
	default 2048


config EXAMPLES_SLAVE_BOARDCTL_MYLEDS_LEDSET
	hex "Subset of SLAVE BOARDCTL MYLEDs to use"
	default 0x0f

endif # EXAMPLES_SLAVE_BOARDCTL_MYLEDS
```
